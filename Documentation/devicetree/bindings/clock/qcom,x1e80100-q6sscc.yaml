## Documentation/devicetree/bindings/clock/qcom,x1e80100-q6sscc.yaml
```yaml
# SPDX-License-Identifier: (GPL-2.0-only OR BSD-2-Clause)
%YAML 1.2
---
$id: http://devicetree.org/schemas/clock/qcom,x1e80100-q6sscc.yaml#
$schema: http://devicetree.org/meta-schemas/core.yaml#

title: Qualcomm X1E80100 QDSP6SS Q6 core clock controller

maintainers:
  - Kirill Mitrofanov <kmitrqq@gmail.com>

description: |
  The Q6 core PLL and core RCG inside the QDSP6 subsystem of the X1E80100
  ADSP and CDSP. Only Linux running at EL2 without the hypervisor uses it;
  otherwise the hypervisor programs these clocks.

  See also: include/dt-bindings/clock/qcom,x1e80100-q6sscc.h

properties:
  compatible:
    enum:
      - qcom,x1e80100-adsp-q6sscc
      - qcom,x1e80100-cdsp-q6sscc

  reg:
    maxItems: 1

  clocks:
    items:
      - description: XO reference clock

  '#clock-cells':
    const: 1

required:
  - compatible
  - reg
  - clocks
  - '#clock-cells'

additionalProperties: false

examples:
  - |
    #include <dt-bindings/clock/qcom,rpmh.h>

    clock-controller@32340000 {
        compatible = "qcom,x1e80100-cdsp-q6sscc";
        reg = <0x32340000 0x10000>;
        clocks = <&rpmhcc RPMH_CXO_CLK>;
        #clock-cells = <1>;
    };
```
