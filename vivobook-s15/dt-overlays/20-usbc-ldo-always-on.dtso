// SPDX-License-Identifier: GPL-2.0
// Overlay for qcom/x1e80100-asus-vivobook-s15-el2.dtb (applied by kernel/build.sh)
// EXPERIMENT 2026-09-29: both USB-C PHY sets share L2J (1.2 V) and L3J (0.8 V) with only eDP/NVMe PHYs.
// With USB wakeup off on both USB-C controllers they switch fully off in suspend and the SoC resets or
// hangs; Windows keeps LDO2_J/LDO3_J on (LPM) while USB is wake-armed. Test: keep them always on.
/dts-v1/;
/plugin/;
/ { compatible = "asus,vivobook-s15"; };
&{/soc@0/rsc@17500000/regulators-7/ldo2} { regulator-always-on; };
&{/soc@0/rsc@17500000/regulators-7/ldo3} { regulator-always-on; };
